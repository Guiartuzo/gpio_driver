/dts-v1/;
/plugin/;

/ {
	compatible = "brcm,bcm2835";

	fragment@0 {
		target-path = "/";
		__overlay__ {
			mygpio: mygpio {
				compatible = "gui,mygpio";
				led-gpios = <&gpio 21 0>;
				status = "okay";
			};
		};
	};
};
